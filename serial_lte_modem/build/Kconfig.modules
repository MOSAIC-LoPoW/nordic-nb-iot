## serial_lte_modem/build/Kconfig.modules
```kconfig
osource "/home/thomas/Documents/UA/Doctoraat/projects/nb-iot-multiple-bs/ncs/nrf/Kconfig.nrf"

osource "/home/thomas/Documents/UA/Doctoraat/projects/nb-iot-multiple-bs/ncs/mcuboot/zephyr/Kconfig"

osource "/home/thomas/Documents/UA/Doctoraat/projects/nb-iot-multiple-bs/ncs/nrfxlib/Kconfig.nrfxlib"
```

## serial_lte_modem/build/spm/Kconfig.modules
```kconfig
osource "/home/thomas/Documents/UA/Doctoraat/projects/nb-iot-multiple-bs/code/ncs/nrf/Kconfig.nrf"

osource "/home/thomas/Documents/UA/Doctoraat/projects/nb-iot-multiple-bs/code/ncs/mcuboot/zephyr/Kconfig"

osource "/home/thomas/Documents/UA/Doctoraat/projects/nb-iot-multiple-bs/code/ncs/nrfxlib/Kconfig.nrfxlib"
```
