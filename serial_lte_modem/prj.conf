## prj.conf
```kconfig
#
# Copyright (c) 2019 Nordic Semiconductor ASA
#
# SPDX-License-Identifier: LicenseRef-BSD-5-Clause-Nordic
#
# General config
CONFIG_LOG=y
CONFIG_LOG_DEFAULT_LEVEL=3
CONFIG_STACK_SENTINEL=y

# Network
CONFIG_NETWORKING=y
CONFIG_NET_SOCKETS=y
CONFIG_NET_NATIVE=n

# BSD library
CONFIG_BSD_LIBRARY=y
CONFIG_BSD_LIBRARY_TRACE_ENABLED=y

# Use GPIO
CONFIG_GPIO=y
CONFIG_GPIO_NRFX=y
CONFIG_GPIO_NRF_P0=y

# UART interface
CONFIG_SERIAL=y
CONFIG_UART_INTERRUPT_DRIVEN=y
CONFIG_UART_2_NRF_UARTE=y
CONFIG_UART_2_NRF_FLOW_CONTROL=y

# LTE link control
CONFIG_LTE_LINK_CONTROL=y
CONFIG_LTE_AUTO_INIT_AND_CONNECT=n

# Stacks and heaps
CONFIG_MAIN_STACK_SIZE=4096
CONFIG_HEAP_MEM_POOL_SIZE=16384
CONFIG_SYSTEM_WORKQUEUE_STACK_SIZE=8192

# AT_CMD
# Enable AT_CMD debug for details
CONFIG_AT_CMD_LOG_LEVEL_DBG=y

# Device power management
# Not ready for nRF91 in Zephyr yet
#CONFIG_DEVICE_POWER_MANAGEMENT=y

# Application-specific
CONFIG_SLM_TCPIP_AT_MODE=y
CONFIG_SLM_GPS_AT_MODE=y
CONFIG_SLM_LOG_LEVEL_INF=y
# Use UART_2 when working with external MCU
#CONFIG_SLM_CONNECT_UART_2=y
# Enable GPIO wakeup when working with external MCU
#CONFIG_SLM_GPIO_WAKEUP=y

##########################################
CONFIG_LOG_DETECT_MISSED_STRDUP=n  # logging issue solved
CONFIG_FLOAT=y

#CONFIG_LTE_PSM_REQ_RAT="00000101"  # go to PSM after 2s of active time (see https://www.arib.or.jp/english/html/overview/doc/STD-T63V12_00/5_Appendix/Rel13/24/24008-d50.pdf Chapter 10.5.7.3)
#CONFIG_LTE_PSM_REQ_RPTAU="00101010" # udp_gps sample: "00101010"
##########################################
```

## src/main.c
```c
/*
 * Copyright (c) 2019 Nordic Semiconductor ASA
 *
 * SPDX-License-Identifier: LicenseRef-BSD-5-Clause-Nordic
 */
#include <logging/log.h>

#include <zephyr.h>
#include <stdio.h>
#include <uart.h>
#include <string.h>
#include <bsd.h>
#include <lte_lc.h>
#include <hal/nrf_gpio.h>
#include <hal/nrf_power.h>
#include <hal/nrf_regulators.h>
#include "slm_at_host.h"

#if defined(CONFIG_SLM_CONNECT_UART_0) && defined(CONFIG_SLM_GPIO_WAKEUP)
#error CONFIG_SLM_GPIO_WAKEUP should not be defined when UART0 is used
#endif

LOG_MODULE_REGISTER(app, CONFIG_SLM_LOG_LEVEL);

/* global variable used across different files */
struct at_param_list m_param_list;

/**@brief Recoverable BSD library error. */
void bsd_recoverable_error_handler(uint32_t err)
{
	LOG_ERR("bsdlib recoverable error: %u", err);
}

void start_execute(void)
{
	int err;

	LOG_INF("NB-IoT DATA COLLECTION PROGRAM");
	err = slm_at_host_init();
	if (err != 0) {
		LOG_ERR("Failed to init at_host: %d", err);
		return;
	}

	/* Initialize AT Parser */
	err = at_params_list_init(&m_param_list, CONFIG_SLM_AT_MAX_PARAM);
	if (err) {
		LOG_ERR("Failed to init AT Parser: %d", err);
		return;
	}
}

void enter_sleep(u16_t mode)
{
	if (mode == SHUTDOWN_MODEM_ONLY) {
		lte_lc_power_off();
		return;
	}

#if defined(CONFIG_SLM_GPIO_WAKEUP)
	/*
	 * Due to errata 4, Always configure PIN_CNF[n].INPUT before
	 *  PIN_CNF[n].SENSE.
	 */
	nrf_gpio_cfg_input(CONFIG_SLM_MODEM_WAKEUP_PIN,
		NRF_GPIO_PIN_PULLUP);
	nrf_gpio_cfg_sense_set(CONFIG_SLM_MODEM_WAKEUP_PIN,
		NRF_GPIO_PIN_SENSE_LOW);
#endif

	/*
	 * The LTE modem also needs to be stopped by issuing a command
	 * through the modem API, before entering System OFF mode.
	 * Once the command is issued, one should wait for the modem
	 * to respond that it actually has stopped as there may be a
	 * delay until modem is disconnected from the network.
	 * Refer to https://infocenter.nordicsemi.com/topic/ps_nrf9160/
	 * pmu.html?cp=2_0_0_4_0_0_1#system_off_mode
	 */
	if (mode == SHUTDOWN_APP_MODEM) {
		lte_lc_power_off();
	}
	bsd_shutdown();
	nrf_regulators_system_off(NRF_REGULATORS_NS);
}

#if defined(CONFIG_SLM_GPIO_WAKEUP)
void main(void)
{
	u32_t rr = nrf_power_resetreas_get(NRF_POWER_NS);

	LOG_DBG("RR: 0x%08x", rr);
	if (rr & NRF_POWER_RESETREAS_OFF_MASK) {
		nrf_power_resetreas_clear(NRF_POWER_NS, 0x70017);
		start_execute();
	} else {
		LOG_INF("Sleep");
		enter_sleep(SHUTDOWN_APP_MODEM);
	}
}
#else
void main(void)
{
	start_execute();
	
	while(1)
	{
		//send_message(); // also uncomment GPS init in slm_at_host.c and uncomment XSYSTEMMODE command!
		send_message_without_gps();
		k_sleep(K_SECONDS(5));
	}
}
#endif	/* CONFIG_THIN_GPIO_WAKEUP */
```

## src/slm_at_gps.c
```c
/*
 * Copyright (c) 2019 Nordic Semiconductor ASA
 *
 * SPDX-License-Identifier: LicenseRef-BSD-5-Clause-Nordic
 */
#include <logging/log.h>

#include <zephyr.h>
#include <stdio.h>
//#include <nrf_socket.h>
#include <net/socket.h>
#include "slm_at_gps.h"

///////////////////////////////////////////////////////////////////////////
#define AT_XSYSTEMMODE "AT\%XSYSTEMMODE=0,1,1,0"  // enable NB1 and GNSS
#define AT_CFUN0       "AT+CFUN=0" // off
#define AT_CFUN1       "AT+CFUN=1" // on
#define AT_CPSMS1	   "AT+CPSMS=1,\"\",\"\",\"10101010\",\"00000001\""

#ifdef CONFIG_BOARD_NRF9160_PCA10090NS
#define AT_MAGPIO      "AT\%XMAGPIO=1,0,0,1,1,1574,1577"
#define AT_COEX0       "AT\%XCOEX0=1,1,1570,1580"
#endif

static const char     gps_at_commands[][40]  = {
				//AT_XSYSTEMMODE, // already enabled both in TCP/IP
#ifdef CONFIG_BOARD_NRF9160_PCA10090NS
				AT_MAGPIO,
				AT_COEX0,
#endif
				AT_CFUN1,
				AT_CPSMS1 /////////////////////////////////
			};
///////////////////////////////////////////////////////////////////////////

LOG_MODULE_REGISTER(gps, CONFIG_SLM_LOG_LEVEL);

#define IS_FIX(_flag)       (_flag & NRF_GNSS_PVT_FLAG_FIX_VALID_BIT)
#define IS_UNHEALTHY(_flag) (_flag & NRF_GNSS_SV_FLAG_UNHEALTHY)

#define INVALID_SOCKET	-1

/**@brief List of supported AT commands. */
enum slm_gps_mode {
	GPS_MODE_STANDALONE,
	GPS_MODE_PSM,
	GPS_MODE_EDRX,
	GPS_MODE_AGPS
};

/**@brief List of supported AT commands. */
enum slm_gps_at_cmd_type {
	AT_GPSRUN,
	AT_GPS_MAX
};

/** forward declaration of cmd handlers **/
static int handle_at_gpsrun(enum at_cmd_type cmd_type);

/**@brief SLM AT Command list type. */
static slm_at_cmd_list_t m_gps_at_list[AT_GPS_MAX] = {
	{AT_GPSRUN, "AT#XGPSRUN", handle_at_gpsrun},
};

//////////////////////////////////////
struct gps_client gps_client_inst; 
nrf_gnss_data_frame_t gps_data; // was static
struct current_loc current_location;
uint8_t notified = 0;
//////////////////////////////////////////

static char buf[64];

#define THREAD_STACK_SIZE	KB(1)
#define THREAD_PRIORITY		K_LOWEST_APPLICATION_THREAD_PRIO

static struct k_thread gps_thread;
static k_tid_t gps_thread_id;
static K_THREAD_STACK_DEFINE(gps_thread_stack, THREAD_STACK_SIZE);
static u64_t ttft_start;



/* global variable defined in different files */
extern struct at_param_list m_param_list;

static void gps_satellite_stats(void)
{
	static u8_t last_tracked;
	u8_t tracked = 0;
	u8_t in_fix = 0;
	u8_t unhealthy = 0;

	if (gps_data.data_id != NRF_GNSS_PVT_DATA_ID || gps_client_inst.has_fix) {
		return;
	}

	for (int i = 0; i < NRF_GNSS_MAX_SATELLITES; ++i) {
		if ((gps_data.pvt.sv[i].sv > 0) &&
		    (gps_data.pvt.sv[i].sv < 33)) {
			LOG_DBG("GPS tracking: %d", gps_data.pvt.sv[i].sv);
			tracked++;
			if (IS_FIX(gps_data.pvt.sv[i].flags)) {
				in_fix++;
			}
			if (IS_UNHEALTHY(gps_data.pvt.sv[i].flags)) {
				unhealthy++;
			}
		}
	}

	if (last_tracked != tracked) {
		sprintf(buf, "#XGPSS: tracking %d using %d unhealthy %d\r\n",
			tracked, in_fix, unhealthy);
		gps_client_inst.callback(buf);
		last_tracked = tracked;
	}
}

static void gps_pvt_notify(void)
{
	///////////////////////////////////////////////////
	LOG_INF("NOTIFY!");
	notified = 1;
	current_location.lat = gps_data.pvt.latitude;
	current_location.lon = gps_data.pvt.longitude;
	current_location.alt = gps_data.pvt.altitude;
	current_location.hdop = gps_data.pvt.hdop;
	current_location.datetime = gps_data.pvt.datetime;
	///////////////////////////////////////////////////

	// sprintf(buf, "#XGPSP: long %f lat %f\r\n",
	// 	gps_data.pvt.longitude,
	// 	gps_data.pvt.latitude);

	gps_client_inst.callback(buf);
	sprintf(buf, "#XGPSP: %04u-%02u-%02u %02u:%02u:%02u\r\n",
		gps_data.pvt.datetime.year,
		gps_data.pvt.datetime.month,
		gps_data.pvt.datetime.day,
		gps_data.pvt.datetime.hour,
		gps_data.pvt.datetime.minute,
		gps_data.pvt.datetime.seconds);
	gps_client_inst.callback(buf);
}

static void gps_thread_fn(void *arg1, void *arg2, void *arg3)
{
	ARG_UNUSED(arg1);
	ARG_UNUSED(arg2);
	ARG_UNUSED(arg3);

	while (true) {
		if (nrf_recv(gps_client_inst.sock, &gps_data, sizeof(gps_data), 0)
			<= 0) {
			LOG_ERR("GPS nrf_recv(): %d", -errno);
			sprintf(buf, "#XGPSRUN: %d\r\n", -errno);
			gps_client_inst.callback(buf);
			nrf_close(gps_client_inst.sock);
			gps_client_inst.running = false;
			break;
		}
		gps_satellite_stats();
		switch (gps_data.data_id) {
		case NRF_GNSS_PVT_DATA_ID:
			//LOG_INF("PVT");
			if (IS_FIX(gps_data.pvt.flags)) {
				//LOG_INF("PVT HAS FIX");
				gps_pvt_notify();
				if (!gps_client_inst.has_fix) {
					u64_t now = k_uptime_get();
					sprintf(buf, "#	: TTFF %d sec\r\n",
						(int)(now - ttft_start)/1000);
					gps_client_inst.callback(buf);
					gps_client_inst.has_fix = true;
				}
			}
			break;
		case NRF_GNSS_NMEA_DATA_ID:
			//LOG_INF("NMEA");
			if (gps_client_inst.has_fix) {
				//LOG_INF("NMEA HAS FIX");
				//gps_client_inst.callback("#XGPSN: ");
				//gps_client_inst.callback(gps_data.nmea);
			}
			break;
		default:
			break;
		}
	}
}

static int do_gps_start(void)
{
	int ret = -EINVAL;

	nrf_gnss_fix_retry_t    fix_retry    = 0; /* unlimited retry period */
	nrf_gnss_fix_interval_t fix_interval = 1; /* 1s delay between fixes */
	nrf_gnss_delete_mask_t  delete_mask  = 0;
	nrf_gnss_nmea_mask_t    nmea_mask = (nrf_gnss_nmea_mask_t)gps_client_inst.mask;
	//nrf_gnss_power_save_mode_t power_mode = 1; ////////////////////////////////////

	gps_client_inst.sock = nrf_socket(NRF_AF_LOCAL, NRF_SOCK_DGRAM, NRF_PROTO_GNSS);
	if (gps_client_inst.sock < 0) {
		LOG_ERR("Could not init socket (err: %d)", -errno);
		goto error;
	}
	ret = nrf_setsockopt(gps_client_inst.sock, NRF_SOL_GNSS, NRF_SO_GNSS_FIX_RETRY,
			&fix_retry, sizeof(fix_retry));
	if (ret != 0) {
		LOG_ERR("Failed to set fix retry value (err: %d)", -errno);
		goto error;
	}
	ret = nrf_setsockopt(gps_client_inst.sock, NRF_SOL_GNSS,
		NRF_SO_GNSS_FIX_INTERVAL, &fix_interval, sizeof(fix_interval));
	if (ret != 0) {
		LOG_ERR("Failed to set fix interval value (err: %d)", -errno);
		goto error;
	}


	//////////////////////////////////////////////////////////
	// ret = nrf_setsockopt(gps_client_inst.sock, NRF_SOL_GNSS, NRF_SO_GNSS_POWER_SAVE_MODE,
	// 		&power_mode, sizeof(power_mode));
    // if (ret != 0) {
    //     LOG_ERR("Failed to set GPS power mode policy (err: %d)", -errno);
	// 	goto error;
	// }
	//////////////////////////////////////////////////////////


	ret = nrf_setsockopt(gps_client_inst.sock, NRF_SOL_GNSS, NRF_SO_GNSS_NMEA_MASK,
			&nmea_mask, sizeof(nmea_mask));
	if (ret != 0) {
		LOG_ERR("Failed to set nmea mask (err: %d)", -errno);
		goto error;
	}
	ret = nrf_setsockopt(gps_client_inst.sock, NRF_SOL_GNSS, NRF_SO_GNSS_START,
			&delete_mask, sizeof(delete_mask));
	if (ret != 0) {
		LOG_ERR("Failed to start GPS (err: %d)", -errno);
		goto error;
	}


	/* Start GPS listening thread */
	if (gps_thread_id != NULL) {
		k_thread_resume(gps_thread_id);
	} else {
		gps_thread_id = k_thread_create(&gps_thread, gps_thread_stack,
				K_THREAD_STACK_SIZEOF(gps_thread_stack),
				gps_thread_fn, NULL, NULL, NULL,
				THREAD_PRIORITY, 0, K_NO_WAIT);
	}

	gps_client_inst.running = true;
	LOG_DBG("GPS started");

	sprintf(buf, "#XGPSRUN: 1,%d\r\n", gps_client_inst.mask);
	gps_client_inst.callback(buf);
	ttft_start = k_uptime_get();
	return 0;

error:
	LOG_ERR("GPS start failed: %d", ret);
	sprintf(buf, "#XGPSRUN: %d\r\n", ret);
	gps_client_inst.callback(buf);
	gps_client_inst.running = false;

	return -errno;
}

static int do_gps_stop(void)
{
	int ret = 0;
	nrf_gnss_delete_mask_t	delete_mask  = 0;

	if (gps_client_inst.sock != INVALID_SOCKET) {
		ret = nrf_setsockopt(gps_client_inst.sock, NRF_SOL_GNSS,
			NRF_SO_GNSS_STOP, &delete_mask, sizeof(delete_mask));
		if (ret != 0) {
			LOG_ERR("Failed to stop GPS (err: %d)", -errno);
			ret = -errno;
		} else {
			k_thread_suspend(gps_thread_id);
			nrf_close(gps_client_inst.sock);
			gps_client_inst.running = false;
			gps_client_inst.callback("#XGPSRUN: 0\r\n");
			LOG_DBG("GPS stopped");
		}

	}

	return ret;
}

/**@brief handle AT#XPSRUN commands
 *  AT#XGPSRUN=<op>[,<mask>]
 *  AT#XGPSRUN?
 *  AT#XGPSRUN=? TEST command not supported
 */
static int handle_at_gpsrun(enum at_cmd_type cmd_type)
{
	int err = -EINVAL;
	u16_t op;

	switch (cmd_type) {
	case AT_CMD_TYPE_SET_COMMAND:
		if (at_params_valid_count_get(&m_param_list) < 2) {
			return -EINVAL;
		}
		err = at_params_short_get(&m_param_list, 1, &op);
		if (err < 0) {
			return err;
		}
		if (op == 1) {
			if (at_params_valid_count_get(&m_param_list) > 2) {
				err = at_params_short_get(&m_param_list, 2,
							&gps_client_inst.mask);
				if (err < 0) {
					return err;
				}
			}
			if (gps_client_inst.running) {
				LOG_WRN("GPS is running");
			} else {
				err = do_gps_start();
			}
		} else if (op == 0) {
			if (!gps_client_inst.running) {
				LOG_WRN("GPS is not running");
			} else {
				err = do_gps_stop();
			}
		} break;

	case AT_CMD_TYPE_READ_COMMAND:
		if (gps_client_inst.running) {
			sprintf(buf, "#XGPSRUN: 1,%d\r\n", gps_client_inst.mask);
		} else {
			sprintf(buf, "#XGPSRUN: 0\r\n");
		}
		gps_client_inst.callback(buf);
		err = 0;
		break;

	default:
		break;
	}

	return err;
}

/**@brief API to handle GPS AT commands
 */
int slm_at_gps_parse(const char *at_cmd)
{
	int ret = -ENOTSUP;
	enum at_cmd_type type;

	for (int i = 0; i < AT_GPS_MAX; i++) {
		u8_t cmd_len = strlen(m_gps_at_list[i].string);

		if (slm_at_cmd_cmp(at_cmd, m_gps_at_list[i].string, cmd_len)) {
			ret = at_parser_params_from_str(at_cmd, NULL,
						&m_param_list);
			if (ret < 0) {
				LOG_ERR("Failed to parse AT command %d", ret);
				return -EINVAL;
			}
			type = at_parser_cmd_type_get(at_cmd);
			ret = m_gps_at_list[i].handler(type);
			break;
		}
	}

	return ret;
}

/////////////////////////////////////////////////////////////////////////////
static int enable_gps(void)
{
	LOG_INF("Initializing GPS Module");

	int  at_sock;
	int  bytes_sent;
	int  bytes_received;
	char buf[2];

	at_sock = socket(AF_LTE, 0, NPROTO_AT);
	if (at_sock < 0) {
		return -1;
	}

	for (int i = 0; i < ARRAY_SIZE(gps_at_commands); i++) {
		LOG_INF("%s",gps_at_commands[i]);
		bytes_sent = send(at_sock, gps_at_commands[i],
				  strlen(gps_at_commands[i]), 0);

		if (bytes_sent < 0) {
			close(at_sock);
			return -1;
		}

		do {
			bytes_received = recv(at_sock, buf, 2, 0);
		} while (bytes_received == 0);

		if (memcmp(buf, "OK", 2) != 0) {
			close(at_sock);
			LOG_ERR("failed to enable GPS");
			return -1;
		}
		//at_cmd_write(gps_at_commands[i], NULL, 0, NULL);
		k_sleep(K_SECONDS(1));
	
	}
	
	close(at_sock);
	LOG_INF("GPS Enabled");

	return 0;
}
///////////////////////////////////////////////////////////////////////////

/**@brief API to initialize GPS AT commands handler
 */
int slm_at_gps_init(at_cmd_handler_t callback)
{
	if (callback == NULL) {
		LOG_ERR("No callback");
		return -EINVAL;
	}
	gps_client_inst.sock = INVALID_SOCKET;
	// gps_client_inst.mask =  NRF_GNSS_NMEA_GSV_MASK |
	// 	       NRF_GNSS_NMEA_GSA_MASK |
	// 	       NRF_GNSS_NMEA_GLL_MASK |
	// 	       NRF_GNSS_NMEA_GGA_MASK |
	// 	       NRF_GNSS_NMEA_RMC_MASK;
	gps_client_inst.mask = NRF_GNSS_NMEA_GGA_MASK; ///////////////////////
	gps_client_inst.running = false;
	gps_client_inst.has_fix = false;
	gps_client_inst.callback = callback;
	gps_thread_id = NULL;

	//////////////////////////////////////////////////////////////////////
	enable_gps();
	do_gps_start();
	//////////////////////////////////////////////////////////////////////

	return 0;
}

/**@brief API to uninitialize GPS AT commands handler
 */
int slm_at_gps_uninit(void)
{
	if (gps_thread_id != NULL) {
		do_gps_stop();
		k_thread_abort(gps_thread_id);
		gps_thread_id = NULL;
	}

	return 0;
}

void wait_for_gps_fix(void)
{
	while(!gps_client_inst.has_fix)
	{
		LOG_INF("waiting for gpsfix");
		k_sleep(K_SECONDS(1));
	}
}

nrf_gnss_data_frame_t* get_gps_data(void)
{
	return &gps_data;
}
```

## src/slm_at_gps.h
```c
/*
 * Copyright (c) 2019 Nordic Semiconductor ASA
 *
 * SPDX-License-Identifier: LicenseRef-BSD-5-Clause-Nordic
 */

#ifndef SLM_AT_GPS_
#define SLM_AT_GPS_

/**@file slm_at_gps.h
 *
 * @brief Vendor-specific AT command for GPS service.
 * @{
 */

#include <nrf_socket.h>
#include <zephyr/types.h>
#include "slm_at_host.h"

//////////////////////////////////////////////////
struct gps_client {
	int sock; /* Socket descriptor. */
	u16_t mask; /* NMEA mask */
	bool running; /* GPS running status */
	bool has_fix; /* At least one fix is got */
	at_cmd_handler_t callback;
};

struct current_loc {
	double lat;
	double lon;
	float alt;
	float hdop;
	nrf_gnss_datetime_t datetime;
};
/////////////////////////////////////////////////

/**
 * @brief GPS AT command parser.
 *
 * @param at_cmd  AT command string.
 *
 * @retval 0 If the operation was successful.
 *           Otherwise, a (negative) error code is returned.
 */
int slm_at_gps_parse(const char *at_cmd);

/**
 * @brief Initialize GPS AT command parser.
 *
 * @param callback Callback function to send AT response
 *
 * @retval 0 If the operation was successful.
 *           Otherwise, a (negative) error code is returned.
 */
int slm_at_gps_init(at_cmd_handler_t callback);

/**
 * @brief Uninitialize GPS AT command parser.
 *
 * @retval 0 If the operation was successful.
 *           Otherwise, a (negative) error code is returned.
 */
int slm_at_gps_uninit(void);

void wait_for_gps_fix(void);

/** @} */

#endif /* SLM_AT_GPS_ */
```

## src/slm_at_host.c
```c
/*
 * Copyright (c) 2019 Nordic Semiconductor ASA
 *
 * SPDX-License-Identifier: LicenseRef-BSD-5-Clause-Nordic
 */

#include <zephyr.h>
#include <stdio.h>
#include <ctype.h>
#include <logging/log.h>
#include <uart.h>
#include <string.h>
#include <init.h>
#include <at_cmd.h>
#include <at_notif.h>

LOG_MODULE_REGISTER(at_host, CONFIG_SLM_LOG_LEVEL);

#if defined(CONFIG_SLM_TCPIP_AT_MODE)
#include "slm_at_tcpip.h"
#endif

#if defined(CONFIG_SLM_GPS_AT_MODE)
#include "slm_at_gps.h"
#endif

#define SLM_UART_0_NAME      "UART_0"
#define SLM_UART_1_NAME      "UART_1"
#define SLM_UART_2_NAME      "UART_2"

#define OK_STR    "OK\r\n"
#define ERROR_STR "ERROR\r\n"

#define SLM_SYNC_STR "Ready\r\n"

#define AT_CMD_SLMVER	"AT#XSLMVER"
#define SLM_VERSION	"#XSLMVER: 1.1\r\n"
#define AT_CMD_SLEEP	"AT#XSLEEP"

#define AT_MAX_CMD_LEN		CONFIG_AT_CMD_RESPONSE_MAX_LEN

/** @brief Termination Modes. */
enum term_modes {
	MODE_NULL_TERM, /**< Null Termination */
	MODE_CR,        /**< CR Termination */
	MODE_LF,        /**< LF Termination */
	MODE_CR_LF,     /**< CR+LF Termination */
	MODE_COUNT      /* Counter of term_modes */
};


/** @brief UARTs. */
enum select_uart {
	UART_0,
	UART_1,
	UART_2
};

static enum term_modes term_mode;
static struct device *uart_dev;
static u8_t at_buf[AT_MAX_CMD_LEN];
static size_t at_buf_len;
static struct k_work cmd_send_work;
static const char termination[3] = { '\0', '\r', '\n' };

/* global variable defined in different files */
extern struct at_param_list m_param_list;
extern void enter_sleep(u16_t mode);

/* forward declaration */
void slm_at_host_uninit(void);

static inline void write_uart_string(char *str, size_t len)
{
	LOG_HEXDUMP_DBG(str, len, "TX");

	for (size_t i = 0; i < len; i++) {
		uart_poll_out(uart_dev, str[i]);
	}
}

static void response_handler(void *context, char *response)
{
	int len = strlen(response) + 1;

	ARG_UNUSED(context);

	/* Forward the data over UART */
	if (len > 1) {
		write_uart_string(response, len);
	}
}

static int handle_at_sleep(const char *at_cmd)
{
	int ret = -EINVAL;
	enum at_cmd_type type;
	u16_t shutdown_mode;

	ret = at_parser_params_from_str(at_cmd, NULL, &m_param_list);
	if (ret < 0) {
		LOG_ERR("Failed to parse AT command %d", ret);
		return -EINVAL;
	}

	type = at_parser_cmd_type_get(at_cmd);
	if (type == AT_CMD_TYPE_SET_COMMAND) {
		if (at_params_valid_count_get(&m_param_list) < 2) {
			LOG_ERR("AT parameter error");
			return -EINVAL;
		}
		ret = at_params_short_get(&m_param_list, 1, &shutdown_mode);
		if (ret < 0) {
			LOG_ERR("AT parameter error");
			return -EINVAL;
		}
		switch (shutdown_mode) {
		case SHUTDOWN_APP_MODEM:
		case SHUTDOWN_APP_ONLY:
			slm_at_host_uninit();
			/* fall over */
		case SHUTDOWN_MODEM_ONLY:
			enter_sleep(shutdown_mode);
			return 0;
		default:
			LOG_ERR("AT parameter error");
			return -EINVAL;
		}
	}

	return ret;
}

static void cmd_send(struct k_work *work)
{
	size_t chars;
	char str[15];
	static char buf[AT_MAX_CMD_LEN];
	enum at_cmd_state state;
	int err;
	size_t size_cmd = sizeof(AT_CMD_SLMVER) - 1;

	ARG_UNUSED(work);

	/* Make sure the string is 0-terminated */
	at_buf[MIN(at_buf_len, AT_MAX_CMD_LEN - 1)] = 0;

	LOG_HEXDUMP_DBG(at_buf, at_buf_len, "RX");

	if (slm_at_cmd_cmp(at_buf, AT_CMD_SLMVER, size_cmd)) {
		write_uart_string(SLM_VERSION, sizeof(SLM_VERSION));
		write_uart_string(OK_STR, sizeof(OK_STR));
		goto done;
	}

	size_cmd = sizeof(AT_CMD_SLEEP) - 1;
	if (slm_at_cmd_cmp(at_buf, AT_CMD_SLEEP, size_cmd)) {
		err = handle_at_sleep(at_buf);
		if (err == 0) {
			write_uart_string(OK_STR, sizeof(OK_STR));
			goto done;
		} else {
			write_uart_string(ERROR_STR, sizeof(ERROR_STR));
			goto done;
		}
	}

#if defined(CONFIG_SLM_TCPIP_AT_MODE)
	err = slm_at_tcpip_parse(at_buf);
	if (err == 0) {
		write_uart_string(OK_STR, sizeof(OK_STR));
		goto done;
	} else if (err != -ENOTSUP) {
		write_uart_string(ERROR_STR, sizeof(ERROR_STR));
		goto done;
	}
#endif /** CONFIG_SLM_TCPIP_AT_MODE */

#if defined(CONFIG_SLM_GPS_AT_MODE)
	err = slm_at_gps_parse(at_buf);
	if (err == 0) {
		write_uart_string(OK_STR, sizeof(OK_STR));
		goto done;
	} else if (err != -ENOTSUP) {
		write_uart_string(ERROR_STR, sizeof(ERROR_STR));
		goto done;
	}
#endif /** CONFIG_SLM_GPS_AT_MODE */

	err = at_cmd_write(at_buf, buf, AT_MAX_CMD_LEN, &state);
	if (err < 0) {
		LOG_ERR("Could not send AT command to modem: %d", err);
		state = AT_CMD_ERROR;
	}

	switch (state) {
	case AT_CMD_OK:
		write_uart_string(buf, strlen(buf));
		write_uart_string(OK_STR, sizeof(OK_STR));
		break;
	case AT_CMD_ERROR:
		write_uart_string(ERROR_STR, sizeof(ERROR_STR));
		break;
	case AT_CMD_ERROR_CMS:
		chars = sprintf(str, "+CMS: %d\r\n", err);
		write_uart_string(str, ++chars);
		break;
	case AT_CMD_ERROR_CME:
		chars = sprintf(str, "+CME: %d\r\n", err);
		write_uart_string(str, ++chars);
		break;
	default:
		break;
	}

done:
	uart_irq_rx_enable(uart_dev);
}

static void uart_rx_handler(u8_t character)
{
	static bool inside_quotes;
	static size_t cmd_len;
	size_t pos;

	cmd_len += 1;
	pos = cmd_len - 1;

	/* Handle special characters. */
	switch (character) {
	case 0x08: /* Backspace. */
		/* Fall through. */
	case 0x7F: /* DEL character */
		pos = pos ? pos - 1 : 0;
		at_buf[pos] = 0;
		cmd_len = cmd_len <= 1 ? 0 : cmd_len - 2;
		break;
	case '"':
		inside_quotes = !inside_quotes;
		 /* Fall through. */
	default:
		/* Detect AT command buffer overflow or zero length */
		if (cmd_len > AT_MAX_CMD_LEN) {
			LOG_ERR("Buffer overflow, dropping '%c'\n", character);
			cmd_len = AT_MAX_CMD_LEN;
			return;
		} else if (cmd_len < 1) {
			LOG_ERR("Invalid AT command length: %d", cmd_len);
			cmd_len = 0;
			return;
		}

		at_buf[pos] = character;
		break;
	}

	if (inside_quotes) {
		return;
	}

	/* Check if the character marks line termination. */
	switch (term_mode) {
	case MODE_NULL_TERM:
		/* Fall through. */
	case MODE_CR:
		if (character == termination[term_mode]) {
			goto send;
		}
		break;
	case MODE_LF:
		if ((at_buf[pos - 1]) &&
			character == termination[term_mode]) {
			goto send;
		}
		break;
	case MODE_CR_LF:
		if ((at_buf[pos - 1] == '\r') && (character == '\n')) {
			goto send;
		}
		break;
	default:
		LOG_ERR("Invalid termination mode: %d", term_mode);
		break;
	}

	return;
send:
	uart_irq_rx_disable(uart_dev);
	k_work_submit(&cmd_send_work);
	at_buf_len = cmd_len;
	cmd_len = 0;
}

static void isr(struct device *dev)
{
	u8_t character;

	uart_irq_update(dev);

	if (!uart_irq_rx_ready(dev)) {
		return;
	}

	while (uart_fifo_read(dev, &character, 1)) {
		uart_rx_handler(character);
	}
}

static int at_uart_init(char *uart_dev_name)
{
	int err;
	u8_t dummy;

	uart_dev = device_get_binding(uart_dev_name);
	if (uart_dev == NULL) {
		LOG_ERR("Cannot bind %s\n", uart_dev_name);
		return -EINVAL;
	}
	/* Wait for the UART line to become valid */
	do {
		err = uart_err_check(uart_dev);
		if (err) {
			LOG_ERR("UART check failed: %d. "
				"Dropping buffer and retrying.", err);

			while (uart_fifo_read(uart_dev, &dummy, 1)) {
				/* Do nothing with the data */
			}
			k_sleep(10);
		}
	} while (err);

	uart_irq_callback_set(uart_dev, isr);
	return err;
}

static void slm_at_callback(char *str)
{
	write_uart_string(str, strlen(str));
}

int slm_at_host_init(void)
{
	char *uart_dev_name;
	int err;
	enum select_uart uart_id = CONFIG_SLM_CONNECT_UART;
	enum term_modes mode = CONFIG_SLM_AT_HOST_TERMINATION;

	/* Choosing the termination mode */
	if (mode < MODE_COUNT) {
		term_mode = mode;
	} else {
		return -EINVAL;
	}

	/* Choose which UART to use */
	switch (uart_id) {
	case UART_0:
		uart_dev_name = SLM_UART_0_NAME;
		break;
	case UART_1:
		uart_dev_name = SLM_UART_1_NAME;
		break;
	case UART_2:
		uart_dev_name = SLM_UART_2_NAME;
		break;
	default:
		LOG_ERR("Unknown UART instance %d", uart_id);
		return -EINVAL;
	}

	err = at_notif_register_handler(NULL, response_handler);
	if (err != 0) {
		LOG_ERR("Can't register handler err=%d", err);
		return err;
	}

	/* Initialize the UART module */
	err = at_uart_init(uart_dev_name);
	if (err) {
		LOG_ERR("UART can not be initialized: %d", err);
		return -EFAULT;
	}

	k_work_init(&cmd_send_work, cmd_send);
	uart_irq_rx_enable(uart_dev);

	write_uart_string(SLM_SYNC_STR, sizeof(SLM_SYNC_STR)-1);

#if defined(CONFIG_SLM_TCPIP_AT_MODE)
	/* Initialize the TCPIP module */
	err = slm_at_tcpip_init(slm_at_callback);
	if (err) {
		LOG_ERR("TCPIP could not be initialized: %d", err);
		return -EFAULT;
	}
#endif
// #if defined(CONFIG_SLM_GPS_AT_MODE) // TODO enable again for GPS to function
// 	/* Initialize the GPS module */
// 	err = slm_at_gps_init(slm_at_callback);
// 	if (err) {
// 		LOG_ERR("GPS could not be initialized: %d", err);
// 		return -EFAULT;
// 	}
// #endif
	LOG_DBG("at_host init done");
	return err;
}

void slm_at_host_uninit(void)
{
	int err;

#if defined(CONFIG_SLM_TCPIP_AT_MODE)
	/* Uninitialize the TCPIP module */
	err = slm_at_tcpip_uninit();
	if (err) {
		LOG_WRN("TCPIP could not be uninitialized: %d", err);
	}
#endif
#if defined(CONFIG_SLM_GPS_AT_MODE)
	/* Uninitialize the GPS module */
	err = slm_at_gps_uninit();
	if (err) {
		LOG_WRN("GPS could not be uninitialized: %d", err);
	}
#endif
	err = at_notif_deregister_handler(NULL, response_handler);
	if (err != 0) {
		LOG_WRN("Can't deregister handler err=%d", err);
	}
#if defined(CONFIG_DEVICE_POWER_MANAGEMENT)
	err = device_set_power_state(uart_dev, DEVICE_PM_OFF_STATE,
				NULL, NULL);
	if (err != 0) {
		LOG_WRN("Can't power off uart err=%d", err);
	}
#endif
	LOG_DBG("at_host uninit done");
}
```

## src/slm_at_tcpip.h
```c
/*
 * Copyright (c) 2019 Nordic Semiconductor ASA
 *
 * SPDX-License-Identifier: LicenseRef-BSD-5-Clause-Nordic
 */

#ifndef SLM_AT_TCPIP_
#define SLM_AT_TCPIP_

/**@file slm_at_tcpip.h
 *
 * @brief Vendor-specific AT command for TCPIP service.
 * @{
 */

#include <zephyr/types.h>
#include "slm_at_host.h"

/**
 * @brief TCP/IP AT command parser.
 *
 * @param at_cmd AT command string.
 *
 * @retval 0 If the operation was successful.
 *           Otherwise, a (negative) error code is returned.
 */
int slm_at_tcpip_parse(const char *at_cmd);

/**
 * @brief Initialize TCP/IP AT command parser.
 *
 * @param callback Callback function to send AT response
 *
 * @retval 0 If the operation was successful.
 *           Otherwise, a (negative) error code is returned.
 */
int slm_at_tcpip_init(at_cmd_handler_t callback);

/**
 * @brief Uninitialize TCP/IP AT command parser.
 *
 * @retval 0 If the operation was successful.
 *           Otherwise, a (negative) error code is returned.
 */
int slm_at_tcpip_uninit(void);
/** @} */

void send_message(void);
void send_message_without_gps(void);

#endif /* SLM_AT_TCPIP_ */
```
